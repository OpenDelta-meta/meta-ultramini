## conf/machine/et7000mini.conf
```bitbake
#@TYPE: Machine
#@NAME: et7000mini
#@DESCRIPTION: Machine configuration for Galaxy Innovations ET-7000 Mini

require conf/machine/include/ultramini-oem.inc

IMAGEDIR = "et7x00"

MACHINE_ESSENTIAL_EXTRA_RDEPENDS += "\
    ultramini-dvb-modules-et7000mini \
    "

DVBMEDIASINK_CONFIG += "--with-vb6 --with-vb8 --with-spark"

RCNAME = "et7x00mini"
```

## conf/machine/include/ultramini-oem.inc
```bitbake
# We know about rtc
MACHINE_FEATURES_BACKFILL_CONSIDERED += "rtc"

KERNELVERSION = "4.1.21"

BOX_BRAND = "ultramini"

MTD_KERNEL = "mtd1"
MTD_ROOTFS = "mtd2"

SOC_FAMILY = "bcm7362"

PREFERRED_VERSION_linux-ultramini = "${KERNELVERSION}"

KERNEL_FILE = "kernel.bin"
ROOTFS_FILE = "rootfs.bin"

DVBPROVIDER = "kernel"
DVBSKYPROVIDER = "kernel"

MACHINE_ESSENTIAL_EXTRA_RDEPENDS += "\
	gstreamer1.0-plugin-dvbmediasink \
	"

DVBMEDIASINK_CONFIG = "--with-wma --with-wmv --with-pcm --with-dtsdownmix"

TARGET_ARCH = "mipsel"
DEFAULTTUNE = "mips32el"

PREFERRED_PROVIDER_virtual/kernel = "linux-ultramini"
PREFERRED_PROVIDER_virtual/blindscan-dvbc = "ultramini-blindscan-utils-dvbc"
PREFERRED_PROVIDER_virtual/blindscan-dvbs = "ultramini-blindscan-utils-dvbs"

KERNEL_IMAGETYPE = "vmlinux"
KERNEL_OUTPUT = "${KERNEL_IMAGETYPE}"
KERNEL_CONSOLE = "ttyS0,115200n8"

IMAGE_FSTYPES ?= "ubi"

MKUBIFS_ARGS = "-m 2048 -e 126976 -c 4096"
UBINIZE_ARGS = "-m 2048 -p 128KiB"

IMAGE_CMD_ubi_prepend = " \
	rm -rf ${IMAGE_ROOTFS}/boot/*; \
	rm -rf ${IMAGE_ROOTFS}/tmp/*; \
	"

IMAGE_CMD_ubi_append = " \
	mkdir -p ${DEPLOY_DIR_IMAGE}/${IMAGEDIR}; \
	mv ${IMGDEPLOYDIR}/${IMAGE_NAME}${IMAGE_NAME_SUFFIX}.ubi ${DEPLOY_DIR_IMAGE}/${IMAGEDIR}/${ROOTFS_FILE}; \
	gzip -9c ${DEPLOY_DIR_IMAGE}/vmlinux-${MACHINE}.bin > ${DEPLOY_DIR_IMAGE}/${IMAGEDIR}/${KERNEL_FILE}; \
	echo ${IMAGE_NAME} > ${DEPLOY_DIR_IMAGE}/${IMAGEDIR}/imageversion; \
	echo "rename this file to 'force' to force an update without confirmation" > ${DEPLOY_DIR_IMAGE}/${IMAGEDIR}/noforce; \
	rm -f ${DEPLOY_DIR_IMAGE}/*.zip; \
	cd ${DEPLOY_DIR_IMAGE}; \
	zip ${IMAGE_NAME}_usb.zip ${IMAGEDIR}/*; \
	rm -f ${DEPLOY_DIR_IMAGE}/*.ubi; \
	rm -f ${DEPLOY_DIR_IMAGE}/*.ubifs; \
	rm -Rf ${IMAGEDIR}; \
	"

MACHINE_FEATURES += "alsa hdmicec switchoff videoenhancement blindscan-tbs HDMI RCA"

# Broken bootloader can only flash around 100 MB
FLASHSIZE = "96"

BOOTLOGO_FILENAME = "splash.bin"

require conf/machine/include/tune-mips32.inc
require conf/machine/include/soc-family.inc

RCTYPE = "504"
```

## conf/machine/xpeedc.conf
```bitbake
#@TYPE: Machine
#@NAME: xpeedlxcc
#@DESCRIPTION: Machine configuration for Golden Interstar Xpeed LX Class C/S2

require conf/machine/include/ultramini-oem.inc

MACHINE_ESSENTIAL_EXTRA_RDEPENDS += "\
    ultramini-dvb-modules-xpeedc \
    "

MACHINE_FEATURES += "dvb-c blindscan-dvbc"

RCNAME = "gi1"
```
